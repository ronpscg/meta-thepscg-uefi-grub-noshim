## conf/layer.conf
```bitbake
# We have a conf and classes directory, add to BBPATH
BBPATH .= ":${LAYERDIR}"

# We have recipes-* directories, add to BBFILES
BBFILES += "${LAYERDIR}/recipes-*/*/*.bb \
            ${LAYERDIR}/recipes-*/*/*.bbappend"

BBFILE_COLLECTIONS += "meta-thepscg-uefi-grub-noshim"
BBFILE_PATTERN_meta-thepscg-uefi-grub-noshim = "^${LAYERDIR}/"
BBFILE_PRIORITY_meta-thepscg-uefi-grub-noshim = "6"

LAYERDEPENDS_meta-thepscg-uefi-grub-noshim = "core"
LAYERSERIES_COMPAT_meta-thepscg-uefi-grub-noshim = "scarthgap"
```
